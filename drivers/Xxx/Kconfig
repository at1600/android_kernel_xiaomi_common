## drivers/Xxx/Kconfig
```kconfig
menu "Xxx module"

source "drivers/Xxx/smart_swappiness/Kconfig"
source "drivers/Xxx/kernel_version/Kconfig"
source "drivers/Xxx/xxx_islandopt/Kconfig"

endmenu
```

## drivers/Xxx/xxx_islandopt/Kconfig
```kconfig
config XXX_ISLAND_OPT
    tristate "XXX_ISLAND_OPT to improve island experience "
	default y
    help
      Used to boost island.
```

## drivers/firmware/cirrus/Kconfig
```kconfig
# SPDX-License-Identifier: GPL-2.0-only

config CL_DSP
	tristate
	default n

config FW_CS_DSP
	tristate
	default n
```

## drivers/mihw/Kconfig
```kconfig
config MI_SPEED_TOUCH
	tristate "mi speed touch"
	depends on MIHW
	help
	  The case is used to monitor speed touch

config MI_DCVS_ARBI
        tristate "mi dcvs arbi"
        default n
        help
          The case is used to manager multi voter clients of dcvs

config MI_POWER_SAVE
    tristate "power save mode 2.0"
    default n
    help
      Power Save Mode 2.0

config MI_UNION_POWER
    tristate "union power load monitor"
    default n
    help
      The case is used to monitor load

config MI_SCHED
        tristate "schedule policy defined by xiaomi"
	depends on MIHW && MI_SCHED_WALT
        default n
        help
          This option can show package runtime info in sup/big/little core.

config MIGT
	tristate "mi game turbo"
	depends on MI_SCHED && SCHED_WALT && MIGT_WALT
	help
	  Improve game peformance and power.

config TURBO_SCHED
	tristate "mi turbo sched"
	depends on MIHW && MI_SCHED
	help
	  Tuning mi-scheduler policy
```

## drivers/mihw/migt/Kconfig
```kconfig
menu "Migt"

config PACKAGE_RUNTIME_INFO
	bool "Show package runtime info on cluster"
	help
	  This option can show package runtime info in sup/big/little core.

config MIGT
	bool "Boost cpufreq during high load"
	depends on PACKAGE_RUNTIME_INFO
	help
	  Boost cpufreq when current frame drawing time too long


config MIGT_ENERGY_MODEL
	bool "DT-based Energy Model for CPU and GPU"
	depends on MIGT
	help
	  This mod rely on Energy Models (EMs) statically defined in
	  the Device Tree. Since EAS now uses only the active costs of CPUs,
	  the cluster-related costs and idle-costs are ignored.

config PERF_HUMANTASK
	bool "Enable MIUI humantask performance feature"
	help
	  This option adds support to switch on/off the sched humantask.

config PERF_CRITICAL_RT_TASK
	bool "Enable set rt binder thread" if EXPERT
	help
	  This option speeds ui feature by setting BlastBufferQueue binder
	  thread to FIFO.

config SF_BINDER
	bool "Enable surfaceflinger binder thread" if EXPERT
	help
	  Xiaomi restore surfaceflinger binder priority FIFO

config MIUI_ZRAM_MEMORY_TRACKING
	bool "Track zRam stats"
	depends on ZRAM
	help
	  With this feature, admin can track the state of zram
	  of zRAM. Admin could see the information via
	  /sys/block/zramX/.

	  See Documentation/blockdev/zram.txt for more information.

config MI_SCHED
        tristate "schedule policy defined by xiaomi"
        depends on MIHW && MI_SCHED_WALT
        default y
        help
          This option can show package runtime info in sup/big/little core.

config TURBO_SCHED
	tristate "mi turbo sched"
	depends on MIHW && MI_SCHED
	help
	  Tuning mi-scheduler policy


source "drivers/mihw/migt/fragmention/Kconfig"


endmenu
```

## drivers/xiaomi/hypsys_netlink/Kconfig
```kconfig
config MI_HYPSYS_NETLINK
	tristate "hypsys communications"
	default y
	help
	  This feature support hypsys communications
```

## drivers/xiaomi/mi_kernel_monitor/Kconfig
```kconfig
config MI_KERNEL_MONITOR
       tristate "Allow xiaomi kernel monitor"
       default y
       help
         Allow xiaomi kernel latency monitor feature
```

## drivers/xiaomi/mi_trace/Kconfig
```kconfig
# SPDX-License-Identifier: GPL-2.0-only

config MI_TRACE
	tristate "mi_trace support"
	default y
	help
		mi trace will record irq and schedule trace log.
```

## drivers/xiaomi/swinfo/Kconfig
```kconfig
# SPDX-License-Identifier: GPL-2.0-only

config MI_SOFTWARE_INFO
	tristate "export software information"
	default y
	help
		swinfo provide the function of exported software information (such as .config).
```
